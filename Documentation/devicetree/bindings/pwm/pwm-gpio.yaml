## Documentation/devicetree/bindings/pwm/pwm-gpio.yaml
```yaml
# SPDX-License-Identifier: (GPL-2.0-only OR BSD-2-Clause)
%YAML 1.2
---
$id: http://devicetree.org/schemas/pwm/pwm-gpio.yaml#
$schema: http://devicetree.org/meta-schemas/core.yaml#

title: Generic software PWM for modulating GPIOs

maintainers:
  - Nicola Di Lieto <nicola.dilieto@gmail.com>

properties:
  "#pwm-cells":
    description: |
      It should be 3. See pwm.yaml in this directory for a
      description of the cells format.
    const: 3

  compatible:
    const: pwm-gpio

  gpios:
    description:
      GPIO to be modulated
    maxItems: 1

required:
  - "#pwm-cells"
  - compatible
  - gpios

additionalProperties: false

examples:
  - |
    #include <dt-bindings/gpio/gpio.h>

    pwm0 {
        #pwm-cells = <3>;
        compatible = "pwm-gpio";
        gpios = <&gpio 1 GPIO_ACTIVE_HIGH>;
    };
```
